## CMakeLists.txt
```
# Project VGA display node CMakeLists configuration
cmake_minimum_required(VERSION 3.20.0)

# always compile for the disco_l475_iot1 board
set(BOARD disco_l475_iot1)

find_package(Zephyr REQUIRED HINTS $ENV{ZEPHYR_BASE})
project(csse4011-thor-gold-vga)

# get the path to OSLIB
set(OSLIB_DIR ../oslib)

# get the required sources and includes from OSLIB
set(OSLIB_SRCS )
#include_directories(${OSLIB_DIR}/bsu_hci ${OSLIB_DIR}/bsu_shell ${OSLIB_DIR}/bsu_bt)

# sources and includes for the app
include_directories(inc)
target_sources(app PRIVATE src/main.c src/vga_shell.c src/vga_driver.c ${OSLIB_SRCS})
```

## prj.conf
```kconfig
#CONFIG_BOOTLOADER_MCUBOOT=y
CONFIG_GPIO=y
CONFIG_PRINTK=y

#-----------------------------SHELL_CONF--------------------------------------
CONFIG_UART_LINE_CTRL=y
CONFIG_SHELL=y
CONFIG_SHELL_PROMPT_UART="CSSE4011:~$ "
CONFIG_SHELL_CMDS=y
CONFIG_SHELL_TAB=y
CONFIG_SHELL_TAB_AUTOCOMPLETION=y
CONFIG_SHELL_VT100_COLORS=y
#-----------------------------------------------------------------------------

#-----------------------------SHELL_LOGGING-----------------------------------
CONFIG_LOG=y
CONFIG_LOG_PRINTK=y

#-----------------------------BLUETOOTH---------------------------------------
CONFIG_BT=y
CONFIG_BT_CENTRAL=y
```

## src/main.c
```c
/*
 * CSSE4011 Project
 * csse4011-thor-gold
 * VGA Node main.c
 * 
 * Nicholas Bassett
 */

#include <zephyr/kernel.h>
#include <zephyr/device.h>
#include <zephyr/drivers/uart.h>
#include <zephyr/logging/log.h>

#include "vga_driver.h"
#include "vga_shell.h"

LOG_MODULE_REGISTER(vga_node);

void main(void) {

    LOG_INF("Starting up VGA node");

	printk("Hello World! %s\n", CONFIG_BOARD);

    init_vga_shell();

    LOG_INF("VGA node initialised");
}
```

## inc/vga_driver.h
```c
#ifndef __VGA_DRIVER_H
#define __VGA_DRIVER_H



#endif // __VGA_DRIVER_H
```

## inc/vga_shell.h
```c
#ifndef __VGA_SHELL_H
#define __VGA_SHELL_H

/**
 * Init the VGA node shell system
 */
void init_vga_shell(void);

#endif // __VGA_SHELL_H
```

## src/vga_driver.c
```c
#include <zephyr/kernel.h>
#include <zephyr/device.h>

#include "vga_driver.h"
```

## src/vga_shell.c
```c
#include <zephyr/shell/shell.h>
#include <zephyr/drivers/uart.h>
#include <zephyr/usb/usb_device.h>
#include <zephyr/logging/log.h>

#include "vga_shell.h"

#define VGA_SHELL_THREAD_PRIORITY 1
#define VGA_SHELL_THREAD_STACK 500

LOG_MODULE_REGISTER(vga_node_shell);

/** 
 * Hello world command handler. Prints "Hello World!" to the shell
 */
static void cmd_hello_world(const struct shell *shell, size_t argc, char **argv) {
    ARG_UNUSED(argc);
    ARG_UNUSED(argv);

    shell_print(shell, "Hello World!\r\n");
}

/* ---- Register Commands ---- */

// register the hello_world command
SHELL_CMD_REGISTER(hello_world, NULL, "Print 'Hello World!'", cmd_hello_world);

/* ---- ---- */

/**
 * Init the VGA node shell system
 */
void init_vga_shell(void) {

    LOG_INF("Initialised the VGA shell");
}

/**
 * @brief Main thread for VGA node command line interface implementation.
 */
void vga_shell_thread(void) {
    const struct device *dev;
    uint32_t dtr = 0;

    dev = DEVICE_DT_GET(DT_CHOSEN(zephyr_shell_uart));
    if (!device_is_ready(dev)) {
        return;
    }

    while (!dtr) {
        uart_line_ctrl_get(dev, UART_LINE_CTRL_DTR, &dtr);
        k_sleep(K_MSEC(100));
    }

    while (1) {
        k_msleep(100);
    }
}

// create the base node shell thread
K_THREAD_DEFINE(vga_shell_thread_tid, VGA_SHELL_THREAD_STACK, vga_shell_thread, NULL, NULL, NULL, VGA_SHELL_THREAD_PRIORITY, 0, 0);
```
